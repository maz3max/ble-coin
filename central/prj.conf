## CMakeLists.txt
```
cmake_minimum_required(VERSION 3.8.2)

set( ENV{ZEPHYR_BASE} ${CMAKE_SOURCE_DIR}/zephyr )
set( ENV{BOARD} native_posix )
set( ENV{ZEPHYR_TOOLCHAIN_VARIANT} zephyr )
set( ENV{ZEPHYR_SDK_INSTALL_DIR} /opt/zephyr-sdk/ )

include($ENV{ZEPHYR_BASE}/cmake/app/boilerplate.cmake NO_POLICY_SCOPE)

project(central)
zephyr_include_directories(
  $ENV{ZEPHYR_BASE}/subsys/bluetooth/host
  ../BLAKE2/ref
)
include_directories(/usr/include/)

target_sources(app PRIVATE src/spaceauth.c ../BLAKE2/ref/blake2s-ref.c src/main.c)
target_link_libraries(app PUBLIC bsd)
```

## prj.conf
```kconfig
CONFIG_BT=y
CONFIG_BT_DEBUG_LOG=y
CONFIG_BT_SMP=y
CONFIG_BT_SIGNING=y
CONFIG_BT_CENTRAL=y
CONFIG_BT_GATT_DIS=y
CONFIG_BT_GATT_CLIENT=y
CONFIG_BT_PRIVACY=y

CONFIG_BT_SMP_SC_ONLY=y
CONFIG_BT_MAX_CONN=1
CONFIG_BT_MAX_PAIRED=50
CONFIG_BT_BONDABLE=n

CONFIG_BT_SETTINGS=y
CONFIG_FLASH=y
CONFIG_FLASH_PAGE_LAYOUT=y
CONFIG_FLASH_MAP=y
CONFIG_FCB=y
CONFIG_SETTINGS=y
CONFIG_SETTINGS_FCB=y
CONFIG_SETTINGS_USE_BASE64=n

CONFIG_LOG=y
CONFIG_ARCH_POSIX=y

CONFIG_STDOUT_CONSOLE=y

CONFIG_FLASH_NATIVE_POSIX=y
CONFIG_FLASH_NATIVE_POSIX_SECTOR_SIZE=4
```

## src/main.c
```c
#include <zephyr.h>


#include <bluetooth/bluetooth.h>
#include <bluetooth/hci.h>
#include <bluetooth/conn.h>
#include <bluetooth/uuid.h>
#include <bluetooth/gatt.h>
#include <bluetooth/crypto.h>
#include <bsd/stdlib.h>
#include <host/conn_internal.h>
#include "hci_core.h"

#include <settings/settings.h>

#include <kernel.h>
#include <soc.h>

#include "spaceauth.h"

#define BLAKE2S_KEYBYTES    32

static struct bt_uuid_128 auth_service_uuid = BT_UUID_INIT_128(
        0xee, 0x8a, 0xcb, 0x07, 0x8d, 0xe1, 0xfc, 0x3b,
        0xfe, 0x8e, 0x69, 0x22, 0x41, 0xbe, 0x87, 0x66);

static struct bt_uuid_128 auth_challenge_uuid = BT_UUID_INIT_128(
        0xd5, 0x12, 0x7b, 0x77, 0xce, 0xba, 0xa7, 0xb1,
        0x86, 0x9a, 0x90, 0x47, 0x02, 0xc9, 0x3d, 0x95);

static struct bt_uuid_128 auth_response_uuid = BT_UUID_INIT_128(
        0x06, 0x3f, 0x0b, 0x51, 0xbf, 0x48, 0x4f, 0x95,
        0x92, 0xd7, 0x28, 0x5c, 0xd6, 0xfd, 0xd2, 0x2f);

static uint16_t bas_svc_handle = 0;
static uint16_t bas_blvl_chr_handle = 0;
static uint16_t bas_blvl_chr_val_handle = 0;
static uint16_t auth_svc_handle = 0;
static uint16_t auth_challenge_chr_handle = 0;
static uint16_t auth_challenge_chr_value_handle = 0;
static uint16_t auth_response_chr_handle = 0;
static uint16_t auth_response_chr_value_handle = 0;
static uint16_t auth_response_chr_ccc_handle = 0;

uint8_t challenge[16];


static u8_t discover_func(struct bt_conn *conn,
                          const struct bt_gatt_attr *attr,
                          struct bt_gatt_discover_params *params);

static u8_t notify_func(struct bt_conn *conn,
                        struct bt_gatt_subscribe_params *params,
                        const void *data, u16_t length){
    if (!data) {
		printk("[UNSUBSCRIBED]\n");
		params->value_handle = 0U;
		return BT_GATT_ITER_STOP;
	}

	printk("[NOTIFICATION] data %p length %u\n", data, length);

	return BT_GATT_ITER_CONTINUE;
}

static struct bt_gatt_discover_params discover_params = {
        .uuid = &auth_service_uuid.uuid,
        .type = BT_GATT_DISCOVER_PRIMARY,
        .func = &discover_func,
        .start_handle = 0x0001,
        .end_handle = 0xffff,
};
static struct bt_gatt_subscribe_params subscribe_params = {
        .value = BT_GATT_CCC_INDICATE,
        .flags = 0,
        .notify = notify_func,
};

static u8_t discover_func(struct bt_conn *conn,
                          const struct bt_gatt_attr *attr,
                          struct bt_gatt_discover_params *params) {
    int err;

    if (!attr) {
        printf("Discover complete\n");
        (void) memset(params, 0, sizeof(*params));
        return BT_GATT_ITER_STOP;
    }
    printk("[ATTRIBUTE] handle %u\n", attr->handle);

    if (!bt_uuid_cmp(params->uuid, &auth_service_uuid.uuid)) {
        printf("found auth service handle\n");
        auth_svc_handle = attr->handle;
        //next up: search challenge chr
        discover_params.uuid = &auth_challenge_uuid.uuid;
        discover_params.start_handle = attr->handle + 1;
        discover_params.type = BT_GATT_DISCOVER_CHARACTERISTIC;

        err = bt_gatt_discover(conn, &discover_params);
        if (err) {
            fprintf(stderr, "challenge chr discovery failed (err %d)\n", err);
        }
    } else if (!bt_uuid_cmp(params->uuid, &auth_challenge_uuid.uuid)) {
        printf("found auth challenge chr handle\n");
        auth_challenge_chr_handle = attr->handle;
        auth_challenge_chr_value_handle = attr->handle + 1;
        //next up: search response chr
        discover_params.start_handle = attr->handle + 2;
        discover_params.uuid = &auth_response_uuid.uuid;

        err = bt_gatt_discover(conn, &discover_params);
        if (err) {
            fprintf(stderr, "challenge chr discovery failed (err %d)\n", err);
        }
    } else if (!bt_uuid_cmp(params->uuid, &auth_response_uuid.uuid)) {
        printf("found auth response chr handle\n");
        auth_response_chr_handle = attr->handle;
        auth_response_chr_value_handle = attr->handle + 1;
        subscribe_params.value_handle = attr->handle + 1; // TODO

        //next up: search response chr cccd
        discover_params.start_handle = attr->handle + 2;
        discover_params.uuid = BT_UUID_GATT_CCC;
        discover_params.type = BT_GATT_DISCOVER_DESCRIPTOR;

        err = bt_gatt_discover(conn, &discover_params);
        if (err) {
            printk("Discover failed (err %d)\n", err);
        }
    } else if (!bt_uuid_cmp(params->uuid, BT_UUID_GATT_CCC)) {
        printf("found auth response chr cccd handle\n");
        auth_response_chr_ccc_handle = attr->handle;
        subscribe_params.ccc_handle = attr->handle;

        err = bt_gatt_subscribe(conn, &subscribe_params);
        if (err && err != -EALREADY) {
            printk("Subscribe failed (err %d)\n", err);
        } else {
            printk("[SUBSCRIBED]\n");
        }

        //next up: search bas svc
        discover_params.uuid = BT_UUID_BAS;
        discover_params.start_handle = 0;
        discover_params.type = BT_GATT_DISCOVER_PRIMARY;

        err = bt_gatt_discover(conn, &discover_params);
        if (err) {
            printk("Discover failed (err %d)\n", err);
        }
    } else if (!bt_uuid_cmp(params->uuid, BT_UUID_BAS)) {
        printf("found bas svc handle\n");
        bas_svc_handle = attr->handle;

        //next up: search bas blvl chr
        discover_params.start_handle = attr->handle + 1;
        discover_params.uuid = BT_UUID_BAS_BATTERY_LEVEL;
        discover_params.type = BT_GATT_DISCOVER_DESCRIPTOR;

        err = bt_gatt_discover(conn, &discover_params);
        if (err) {
            printk("Discover failed (err %d)\n", err);
        }
    } else if (!bt_uuid_cmp(params->uuid, BT_UUID_BAS_BATTERY_LEVEL)) {
        printf("found bas blvl chr handle\n");
        bas_blvl_chr_handle = attr->handle;
        bas_blvl_chr_val_handle = attr->handle + 1; // TODO

        return BT_GATT_ITER_STOP;
    }
    return BT_GATT_ITER_STOP;
}

static FILE *gl = NULL;

void initialize(void) {
    settings_subsys_init();
    FILE *c = fopen("central.txt", "r");
    struct bt_irk id_irk;
    bt_addr_le_t id;
    if (c && deserialize_id(c, &id, &id_irk)) {
        /*
        settings_save_one("bt/id", &id, sizeof(bt_addr_le_t));
        settings_save_one("bt/irk", &id_irk.val, 16);
        */
        int n = bt_id_create(&id, id_irk.val);
        if(n != 0){
            fprintf(stderr, "Oh no! The ID could not be set!");
        }
    } else {
        fprintf(stderr, "Couldn't load central ID!\n");
        exit(-1);
    }
    fclose(c);

    gl = open_guestlist("r");
    struct bt_keys keys;
    uint8_t spacekey[BLAKE2S_KEYBYTES];
    while (gl && deserialize_keys(gl, &keys, spacekey)) {
        space_add_id(&keys, spacekey);
        bt_keys_store(&keys);
    }
    bt_keys_foreach(BT_KEYS_ALL, space_save_id, stdout);
}

static void device_found(const bt_addr_le_t *addr, s8_t rssi, u8_t type,
                         struct net_buf_simple *ad) {
    char addr_str[BT_ADDR_LE_STR_LEN];

    bt_addr_le_to_str(addr, addr_str, sizeof(addr_str));
    printk("Device found: %s (RSSI %d) (TYPE %u) (BONDED %u)\n", addr_str, rssi, type, bt_addr_le_is_bonded(BT_ID_DEFAULT, addr));

    /* We're only interested in directed connectable events from bonded devices*/
    if ((type != BT_LE_ADV_DIRECT_IND && type !=BT_LE_ADV_IND)|| !bt_addr_le_is_bonded(BT_ID_DEFAULT, addr)) {
        return;
    }

    printk("Connecting to device: %s (RSSI %d)\n", addr_str, rssi);

    if (bt_le_scan_stop()) {
        return;
    }

    bt_conn_create_le(addr, BT_LE_CONN_PARAM_DEFAULT);
}

static void connected(struct bt_conn *conn, u8_t err) {
    char addr[BT_ADDR_LE_STR_LEN];

    bt_addr_le_to_str(bt_conn_get_dst(conn), addr, sizeof(addr));

    if (err) {
        printk("Failed to connect to %s (%u)\n", addr, err);
        int error = bt_le_scan_start(BT_LE_SCAN_PASSIVE, device_found);
        if (error) {
        printk("Scanning failed to start (err %d)\n", error);
        }
        return;
    }

    printk("Connected: %s\n", addr);
    int error =bt_conn_security(conn, BT_SECURITY_FIPS);
    if (error) {
        printk("Failed to set security: %i\n", error);
        bt_conn_disconnect(conn, BT_HCI_ERR_INSUFFICIENT_SECURITY);
    }
    printk("Starting Discovery...\n");
    err = bt_gatt_discover(conn, &discover_params);
    if (err) {
        printk("Discover failed(err %d)\n", err);
        return;
    }
}

static void disconnected(struct bt_conn *conn, u8_t reason) {
    char addr[BT_ADDR_LE_STR_LEN];
    int err;

    bt_addr_le_to_str(bt_conn_get_dst(conn), addr, sizeof(addr));

    printk("Disconnected: %s (reason %u)\n", addr, reason);

    err = bt_le_scan_start(BT_LE_SCAN_PASSIVE, device_found);
    if (err) {
        printk("Scanning failed to start (err %d)\n", err);
    }
}

static void identity_resolved(struct bt_conn *conn, const bt_addr_le_t *rpa,
                              const bt_addr_le_t *identity) {
    char addr_identity[BT_ADDR_LE_STR_LEN];
    char addr_rpa[BT_ADDR_LE_STR_LEN];

    bt_addr_le_to_str(identity, addr_identity, sizeof(addr_identity));
    bt_addr_le_to_str(rpa, addr_rpa, sizeof(addr_rpa));

    printk("Identity resolved %s -> %s\n", addr_rpa, addr_identity);
}

static void security_changed(struct bt_conn *conn, bt_security_t level) {
    char addr[BT_ADDR_LE_STR_LEN];

    bt_addr_le_to_str(bt_conn_get_dst(conn), addr, sizeof(addr));

    printk("Security changed: %s level %u\n", addr, level);
}

static struct bt_conn_cb conn_callbacks = {
        .connected = connected,
        .disconnected = disconnected,
        .identity_resolved = identity_resolved,
        .security_changed = security_changed,
};

static void bt_ready(int err)
{
	if (err) {
		printk("Bluetooth init failed (err %d)\n", err);
		return;
	}

	printk("Bluetooth initialized\n");

	if (IS_ENABLED(CONFIG_SETTINGS)) {
		settings_load();
	}

    err = bt_le_scan_start(BT_LE_SCAN_PASSIVE, device_found);

    if (err) {
        printk("Scanning failed to start (err %d)\n", err);
        return;
    }

    printk("Scanning successfully started\n");
}

void main(int argc, char *argv[]) {
    initialize();

    int err;

    err = bt_enable(bt_ready);
	if (err) {
		printk("Bluetooth init failed (err %d)\n", err);
		return;
	}
    printk("Bluetooth initialized\n");

    bt_conn_cb_register(&conn_callbacks);
    bt_conn_auth_cb_register(NULL);
}
```

## src/guestlist.h
```c
#ifndef GUESTLIST_H
#define GUESTLIST_H


#include <keys.h>
#include <bluetooth/hci.h>
#include <stdio.h>
#include <regex.h>
#include <sys/file.h>


static bool deserialize_id(FILE *fp,
                            bt_addr_le_t *id, struct bt_irk *id_irk) {
    const char *rx_str = "^(([[:xdigit:]]{2}\\:){5}[[:xdigit:]]{2})\\s*"    // addr (1,2)
                         "(random|public)\\s*"                              // type of addr (3)
                         "([[:xdigit:]]{32})\\s*";                          // irk (4)
    regex_t rx;
    regmatch_t matches[5];
    regcomp(&rx, rx_str, REG_EXTENDED);
    char *line = NULL;
    size_t len = 0;
    if (getline(&line, &len, fp) > 0 && regexec(&rx, line, 5, matches, 0) == 0 && matches[0].rm_so != -1) {
        for (int i = 0; i < 6; ++i) {
            char buf[3] = {line[matches[1].rm_so + (i * 3)], line[matches[1].rm_so + (i * 3) + 1], 0};
            id->a.val[5 - i] = strtol(buf, NULL, 16);
        }
        if (!strncmp("random", line + matches[3].rm_so, 6)) {
            id->type = BT_ADDR_LE_RANDOM;
        } else if (!strncmp("public", line + matches[3].rm_so, 6)) {
            id->type = BT_ADDR_LE_PUBLIC;
        }
        for (int i = 0; i < 16; ++i) {
            char buf[3] = {line[matches[4].rm_so + (i * 2)], line[matches[4].rm_so + (i * 2) + 1], 0};
            id_irk->val[i] = strtol(buf, NULL, 16);
        }
    } else {
        return false;
    }
    regfree(&rx);
    return true;
}

static bool deserialize_keys(FILE *fp,
                              struct bt_keys *keys, uint8_t *spacekey) {
    const char *rx_str = "^(([[:xdigit:]]{2}\\:){5}[[:xdigit:]]{2})\\s*"    // addr (1,2)
                         "(random|public)\\s*"                              // type of addr (3)
                         "([[:xdigit:]]{32})\\s*"                           // irk (4)
                         "([[:xdigit:]]{32})\\s*"                           // ltk (5)
                         "([[:xdigit:]]{64})";                              // space-key (6)
    regex_t rx;
    regmatch_t matches[11];
    regcomp(&rx, rx_str, REG_EXTENDED);
    char *line = NULL;
    size_t len = 0;
    if (getline(&line, &len, fp) > 0 && regexec(&rx, line, 11, matches, 0) == 0 && matches[0].rm_so != -1) {
        keys->enc_size = BT_ENC_KEY_SIZE_MAX;
        keys->flags = (BT_KEYS_AUTHENTICATED | BT_KEYS_SC);
        keys->keys = (BT_KEYS_IRK | BT_KEYS_LTK_P256);
        keys->id = BT_ID_DEFAULT;

        for (int i = 0; i < 6; ++i) {
            char buf[3] = {line[matches[1].rm_so + (i * 3)], line[matches[1].rm_so + (i * 3) + 1], 0};
            keys->addr.a.val[5 - i] = strtol(buf, NULL, 16);
        }
        if (!strncmp("random", line + matches[3].rm_so, 6)) {
            keys->addr.type = BT_ADDR_LE_RANDOM;
        } else if (!strncmp("public", line + matches[3].rm_so, 6)) {
            keys->addr.type = BT_ADDR_LE_PUBLIC;
        }
        for (int i = 0; i < 16; ++i) {
            char buf[3] = {line[matches[4].rm_so + (i * 2)], line[matches[4].rm_so + (i * 2) + 1], 0};
            keys->irk.val[i] = strtol(buf, NULL, 16);
        }
        for (int i = 0; i < 16; ++i) {
            char buf[3] = {line[matches[5].rm_so + (i * 2)], line[matches[5].rm_so + (i * 2) + 1], 0};
            keys->ltk.val[i] = strtol(buf, NULL, 16);
        }
        for (int i = 0; i < 32; ++i) {
            char buf[3] = {line[matches[6].rm_so + (i * 2)], line[matches[6].rm_so + (i * 2) + 1], 0};
            spacekey[i] = strtol(buf, NULL, 16);
        }
    } else {
        return false;
    }
    regfree(&rx);
    return true;
}

static void serialize_id(bt_addr_le_t *id, struct bt_irk *id_irk,
                          FILE *fp) {
    // addr and addr type
    const char *type = (id->type == BT_ADDR_LE_PUBLIC) ? "public" : "random";
    fprintf(fp, "%02X:%02X:%02X:%02X:%02X:%02X %s ",
            id->a.val[5], id->a.val[4], id->a.val[3],
            id->a.val[2], id->a.val[1], id->a.val[0], type);
    // irk
    for (size_t i = 0; i < 16; ++i) {
        fprintf(fp, "%02X", id_irk->val[i]);
    }
    fprintf(fp, "\n");
}

static void serialize_keys(struct bt_keys *keys, uint8_t *spacekey,
                            FILE *fp) {
    // addr and addr type
    const char *type = (keys->addr.type == BT_ADDR_LE_PUBLIC) ? "public" : "random";
    fprintf(fp, "%02X:%02X:%02X:%02X:%02X:%02X %s ",
            keys->addr.a.val[5], keys->addr.a.val[4], keys->addr.a.val[3],
            keys->addr.a.val[2], keys->addr.a.val[1], keys->addr.a.val[0], type);
    // irk
    for (size_t i = 0; i < 16; ++i) {
        fprintf(fp, "%02X", keys->irk.val[i]);
    }
    fprintf(fp, " ");
    // ltk
    for (size_t i = 0; i < 16; ++i) {
        fprintf(fp, "%02X", keys->ltk.val[i]);
    }
    fprintf(fp, " ");
    // space-key
    for (size_t i = 0; i < 32; ++i) {
        fprintf(fp, "%02X", spacekey[i]);
    }
    fprintf(fp, "\n");
}

static FILE *open_guestlist(const char* mode) {
    FILE *fp = fopen("coins.txt", mode);
    if (fp && flock(fileno(fp), LOCK_EX | LOCK_NB) == 0) {
        return fp;
    }
    fprintf(stderr, "Failed to open guest list\n");
    exit(-1);
    return NULL;
}
#endif
```

## src/spaceauth.c
```c
#include "spaceauth.h"
#include "tinycrypt/utils.h"
#include "blake2.h"
#include "bluetooth/gatt.h"

#include "hci_core.h"

#ifndef CONFIG_BT_MAX_PAIRED
#define CONFIG_BT_MAX_PAIRED -1
#endif

struct space_data {
    bt_addr_le_t id;
    uint8_t key[BLAKE2S_KEYBYTES];
};

static struct space_data periphs[CONFIG_BT_MAX_PAIRED];
static size_t periph_count = 0;

struct space_data *id_exists(const bt_addr_le_t *addr) {

    for (size_t i = 0; i < periph_count; ++i) {
        if (!bt_addr_le_cmp(&periphs[i].id, addr)) {
            return periphs + i;
        }
    }
    return NULL;
}


bool space_add_id(struct bt_keys *keys, uint8_t *key) {
    if (!id_exists(&keys->addr)) {
        memcpy(periphs[periph_count].key, key, BLAKE2S_KEYBYTES);
        memcpy(&periphs[periph_count].id, &keys->addr, sizeof(struct bt_keys));
        periph_count++;
        return true;
    }
    return false;
}

void space_save_id(struct bt_keys *keys, void *arg) {
    FILE *fp = arg;
    struct space_data *s = id_exists(&keys->addr);
    if (s) {
        serialize_keys(keys, s->key, fp);
    }
}

bool check_sign(const bt_addr_le_t *addr, const uint8_t *challenge, const uint8_t *remote_sign) {
    struct space_data *s = id_exists(addr);
    if (s) {
        uint8_t buf[BLAKE2S_OUTBYTES];
        blake2s(buf, BLAKE2S_OUTBYTES, challenge, BLAKE2S_BLOCKBYTES, s->key, BLAKE2S_KEYBYTES);
        if (_compare(buf, remote_sign, BLAKE2S_OUTBYTES) == 0) {
            return true;
        }
    }
    return false;
}
```

## src/spaceauth.h
```c
#ifdef __cplusplus
extern "C" {
#endif

#include "bluetooth/hci.h"
#include "bluetooth/gatt.h"

#include "guestlist.h"

/**
 * Tells host and controller about the new key
 * @param keys BLE keys
 * @param key space key
 * @return true if successful
 */
bool space_add_id(struct bt_keys *keys, uint8_t *key);

/**
 * Check if remote signature is correct
 * @param addr peripheral address
 * @param challenge
 * @param remote_sign
 * @return true for correct signature
 */
bool check_sign(const bt_addr_le_t * addr, const uint8_t * challenge,const uint8_t * remote_sign);

/**
 * Find corresponding space-key and serialize into file given with arg
 * @param keys
 * @param arg FILE* to write to
 */
void space_save_id(struct bt_keys *keys, void *arg);


#ifdef __cplusplus
}
#endif
```
