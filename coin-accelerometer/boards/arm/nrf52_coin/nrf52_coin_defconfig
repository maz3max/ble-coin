## coin-accelerometer/boards/arm/nrf52_coin/nrf52_coin_defconfig
```kconfig
# SPDX-License-Identifier: Apache-2.0

CONFIG_ARM=y
CONFIG_SOC_FAMILY_NRF=y
CONFIG_SOC_SERIES_NRF52X=y
CONFIG_SOC_NRF52832_QFAA=y
CONFIG_BOARD_NRF52_COIN=y

# Enable MPU
CONFIG_ARM_MPU=y

# enable GPIO
CONFIG_GPIO=y

# additional board options
CONFIG_GPIO_AS_PINRESET=y
```

## coin-nrf51/boards/arm/nrf51_coin/Kconfig.board
```kconfig
# Kconfig - nRF51 Coin board configuration
#
# Copyright (c) 2019 Maximilian Deubel
#
# SPDX-License-Identifier: Apache-2.0

config BOARD_NRF51_COIN
	bool "nRF51 COIN"
	depends on SOC_NRF51822_QFAA
```

## coin-nrf51/boards/arm/nrf51_coin/nrf51_coin_defconfig
```kconfig
# SPDX-License-Identifier: Apache-2.0

CONFIG_ARM=y
CONFIG_SOC_FAMILY_NRF=y
CONFIG_SOC_SERIES_NRF51X=y
CONFIG_SOC_NRF51822_QFAA=y
CONFIG_BOARD_NRF51_COIN=y

# enable GPIO
CONFIG_GPIO=y
```

## coin/boards/arm/nrf51_coin/Kconfig.defconfig
```kconfig
# Kconfig - nRF51 Coin board configuration
#
# Copyright (c) 2019 Maximilian Deubel
#
# SPDX-License-Identifier: Apache-2.0

if BOARD_NRF51_COIN

config BOARD
	default "nrf51_coin"

config BT_CTLR
	default BT

endif # BOARD_NRF51_COIN
```

## coin/boards/arm/nrf52_coin/Kconfig
```kconfig
# Kconfig - nRF52 Coin board configuration
#
# Copyright (c) 2019 Fuck Licenses Corp.
#
# SPDX-License-Identifier: Apache-2.0

if BOARD_NRF52_COIN

config BOARD_ENABLE_DCDC
        bool "Enable DCDC mode"
        select SOC_DCDC_NRF52X
        default n

endif # BOARD_NRF52_COIN
```

## coin/boards/arm/nrf52_coin/Kconfig.board
```kconfig
# Kconfig - nRF52 Coin board configuration
#
# Copyright (c) 2019 Maximilian Deubel
#
# SPDX-License-Identifier: Apache-2.0


config  BOARD_NRF52_COIN
	bool "nRF52 Coin"
	depends on SOC_NRF52832_QFAA
```

## coin/boards/arm/nrf52_coin/Kconfig.defconfig
```kconfig
# Kconfig - nRF52 Coin board configuration
#
# Copyright (c) 2019 Maximilian Deubel
#
# SPDX-License-Identifier: Apache-2.0

if BOARD_NRF52_COIN

config BOARD
	default "nrf52_coin"

if ADC

config ADC_0
	default y

endif # ADC

config BT_CTLR
	default BT

endif # BOARD_NRF52_COIN
```
