## CMakeLists.txt
```
cmake_minimum_required(VERSION 3.8.2)

set( ENV{ZEPHYR_BASE} ${CMAKE_SOURCE_DIR}/../zephyr )
set( ENV{BOARD} nrf52_coin )
set( BOARD_ROOT ${CMAKE_SOURCE_DIR}/../coin )
set( ENV{ZEPHYR_TOOLCHAIN_VARIANT} zephyr )
set( ENV{ZEPHYR_SDK_INSTALL_DIR} /opt/zephyr-sdk/ )

include($ENV{ZEPHYR_BASE}/cmake/app/boilerplate.cmake NO_POLICY_SCOPE)

project(coin-bonding)
zephyr_include_directories(
  $ENV{ZEPHYR_BASE}/subsys/bluetooth/host
)


target_sources(app PRIVATE src/main.c)
```

## prj.conf
```kconfig
CONFIG_BT=y
CONFIG_BT_DEBUG_LOG=y
CONFIG_BT_SMP=y
CONFIG_BT_SIGNING=y
CONFIG_BT_PERIPHERAL=y

CONFIG_BT_PRIVACY=y

CONFIG_BT_GATT_DIS=y

CONFIG_BT_SMP_SC_ONLY=y
CONFIG_BT_MAX_CONN=1
CONFIG_BT_MAX_PAIRED=1

CONFIG_BT_SETTINGS=y
CONFIG_BT_BONDABLE=n

CONFIG_FLASH=y
CONFIG_FLASH_PAGE_LAYOUT=y
CONFIG_FLASH_MAP=y
CONFIG_FCB=y
CONFIG_SETTINGS=y
CONFIG_SETTINGS_FCB=y

CONFIG_SYS_POWER_MANAGEMENT=y
CONFIG_SYS_POWER_SLEEP_STATES=y
CONFIG_HAS_SYS_POWER_STATE_SLEEP_2=y
CONFIG_HAS_SYS_POWER_STATE_SLEEP_3=y
CONFIG_SYS_POWER_DEEP_SLEEP_STATES=y
CONFIG_SYS_PM_MIN_RESIDENCY_SLEEP_1=5000
CONFIG_SYS_PM_MIN_RESIDENCY_SLEEP_2=15000
CONFIG_DEVICE_POWER_MANAGEMENT=y
CONFIG_ADC=y
CONFIG_ADC_0=y
```

## src/main.c
```c
#include <zephyr.h>
#include <settings/settings.h>
#include <bluetooth/bluetooth.h>
#include <keys.h> // use of internal BLE keys API

#include "main.h"

void main(void) {

  bt_addr_le_t central_addr = INSERT_CENTRAL_ADDR_HERE;
  struct bt_irk central_irk = {
      .val = INSERT_CENTRAL_IRK_HERE,
      .rpa = {0}
  };
  bt_addr_le_t periph_addr = INSERT_PERIPH_ADDR_HERE;
  struct bt_irk periph_irk = {
      .val = INSERT_PERIPH_IRK_HERE,
      .rpa = {0}
  };
  struct bt_keys periph_keys = {
      .id = BT_ID_DEFAULT,
      .addr = central_addr,
      .irk = central_irk,
      .enc_size = BT_ENC_KEY_SIZE_MAX,
      .flags = (BT_KEYS_AUTHENTICATED | BT_KEYS_SC),
      .keys = (BT_KEYS_IRK | BT_KEYS_LTK_P256),
      .ltk = {.rand = {0},
              .ediv = {0},
              .val = INSERT_LTK_HERE},
  };
  uint8_t spacekey[] = INSERT_SPACEKEY_HERE;

  settings_subsys_init();
  printk("Saving ID\n");
  settings_save_one("bt/id", &periph_addr, sizeof(periph_addr));
  printk("Saving IRK\n");
  settings_save_one("bt/irk", periph_irk.val, 16);
  printk("Saving KEYS (BT_KEYS_STORAGE_LEN=%u)\n", BT_KEYS_STORAGE_LEN);
  bt_keys_store(&periph_keys);
  printk("Saving SpaceKey\n");
  settings_save_one("space/key", &spacekey, sizeof(spacekey));
  printk("Saving Complete!\n");
}
```
